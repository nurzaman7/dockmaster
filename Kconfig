## dts/bindings/dockmaster/dockmaster,ncp-uart.yaml
```yaml
# Copyright (c) 2026 Nurzaman
# SPDX-License-Identifier: Apache-2.0

description: |
  Network co-processor (for example a cellular or LPWAN modem) on a UART,
  driven as a Dockmaster link by drivers/dockmaster_link/dm_link_ncp_uart.c
  with the line protocol documented at the top of that file. The node is a
  child of the UART controller; the baud rate is the controller's
  current-speed.

  This link always reports metered = true and tier "sw": the co-processor
  runs its own channel access, and its bytes are assumed to cost money.

  Example:

    &usart1 {
        current-speed = <115200>;
        dm_ncp: dm-ncp {
            compatible = "dockmaster,ncp-uart";
            latency-us = <250000>;
            probe-period-ms = <30000>;
        };
    };

compatible: "dockmaster,ncp-uart"

include:
  - uart-device.yaml
  - "dockmaster,link-common.yaml"

properties:
  mtu:
    type: int
    default: 120
    description: |
      Largest message in bytes, 1 to 255. A SEND line carries the payload
      in hex, so it is 2 * mtu + 15 characters long.

  latency-us:
    type: int
    default: 100000
    description: |
      Typical time the co-processor needs to deliver one message and
      answer, excluding the UART transfer. Part of the airtime estimate,
      and therefore of the 4x watchdog; the scheduler charges the measured
      round trip.
```

## dts/bindings/dockmaster/dockmaster,spi-phy.yaml
```yaml
# Copyright (c) 2026 Nurzaman
# SPDX-License-Identifier: Apache-2.0

description: |
  Generic external PHY on SPI, driven as a Dockmaster link by
  drivers/dockmaster_link/dm_link_spi_phy.c. The driver assumes a small
  command + FIFO interface documented at the top of that file; it does not
  target any particular product.

  Tier "sw" (default): completion comes from done-gpios. Tier "hw": the
  PHY routes each transmission's done signal to one of two class-line
  outputs (class-line-pins), which the SoC backend named by hw-backend
  turns into separate NVIC interrupts.

  Example:

    &spi1 {
        cs-gpios = <&gpio1 7 GPIO_ACTIVE_LOW>;
        dm_phy: dm-phy@0 {
            compatible = "dockmaster,spi-phy";
            reg = <0>;
            spi-max-frequency = <8000000>;
            done-gpios = <&gpio1 3 GPIO_ACTIVE_HIGH>;
            busy-gpios = <&gpio1 4 GPIO_ACTIVE_HIGH>;
            bitrate-bps = <250000>;
            preamble-us = <160>;
            turnaround-us = <192>;
        };
    };

compatible: "dockmaster,spi-phy"

include:
  - spi-device.yaml
  - "dockmaster,link-common.yaml"

properties:
  done-gpios:
    type: phandle-array
    required: true
    description: |
      PHY output 0, asserted when a transmission has left the antenna and
      held until the next START_TX or ABORT command.

  busy-gpios:
    type: phandle-array
    description: |
      PHY output asserted while the PHY senses the channel busy (CCA or
      CAD). Without it the link has no is_busy and no sw-EDCA.

  mtu:
    type: int
    default: 255
    description: Largest frame in bytes, 1 to 255 (the FIFO length is one byte).

  bitrate-bps:
    type: int
    required: true
    description: |
      On-air bit rate, at least 128. Used only for the airtime estimate;
      the scheduler charges the measured airtime.

  preamble-us:
    type: int
    default: 0
    description: Fixed on-air time per frame (preamble, sync word, PHY header).

  turnaround-us:
    type: int
    default: 0
    description: |
      Receiver-off time per frame after the transmission (TX to RX
      turnaround). Charged as airtime because the PHY is half duplex.

  class-line-pins:
    type: array
    description: |
      Tier "hw" only. The PHY output that signals done for class line 0
      (C0 to C2) and for class line 1 (C3 and C4), as numbers for the
      MAP_IRQ command. Output 0 is the done pin.

  hw-backend:
    type: phandle
    description: |
      Tier "hw" only. The DM_TIER_HW backend node that owns the SoC side
      of the class lines (compatible "dockmaster,hw-nrf-egu").
```

## tests/build/drivers/testcase.yaml
```yaml
common:
  tags: dockmaster
  build_only: true
tests:
  dockmaster.build.drivers:
    platform_allow:
      - nrf52840dk/nrf52840
    integration_platforms:
      - nrf52840dk/nrf52840
  dockmaster.build.drivers.dppi:
    platform_allow:
      - nrf5340dk/nrf5340/cpuapp
    integration_platforms:
      - nrf5340dk/nrf5340/cpuapp
```

## tests/unit/linkmgr/testcase.yaml
```yaml
common:
  tags: dockmaster
  platform_allow:
    - native_sim
    - native_sim/native/64
    - mps2/an385
  integration_platforms:
    - native_sim
tests:
  dockmaster.unit.linkmgr: {}
```

## tests/unit/policy/testcase.yaml
```yaml
common:
  tags: dockmaster
  platform_allow:
    - native_sim
    - native_sim/native/64
    - mps2/an385
  integration_platforms:
    - native_sim
tests:
  dockmaster.unit.policy: {}
  # Same suite over the real persistence path: settings on NVS on the
  # native_sim flash simulator.
  dockmaster.unit.policy.settings_nvs:
    filter: CONFIG_ARCH_POSIX
    extra_configs:
      - CONFIG_FLASH=y
      - CONFIG_FLASH_MAP=y
      - CONFIG_NVS=y
      - CONFIG_SETTINGS=y
      - CONFIG_SETTINGS_NVS=y
```
