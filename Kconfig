## Kconfig
```kconfig
# Copyright (c) 2026 Nurzaman
# SPDX-License-Identifier: Apache-2.0

menuconfig DOCKMASTER
	bool "Dockmaster firmware QoS for multi-radio devices"
	select POLL
	select CRC
	help
	  One traffic-class table, one airtime scheduler and one link selector
	  for devices with several radios. See doc/spec.md.

if DOCKMASTER

DT_COMPAT_DM_HW_NRF_EGU := dockmaster,hw-nrf-egu
DT_COMPAT_DM_GPIO_PROBES := dockmaster,gpio-probes

menu "Queues and memory"

config DM_SLAB_BLOCK
	int "Slab block size in bytes (16 byte header included)"
	default 256
	range 64 4096
	help
	  Every payload lives in one block of this size. The first 16 bytes of
	  each block are the message header.

config DM_SLAB_COUNT
	int "Number of slab blocks"
	default 32
	range 4 1024

config DM_MAX_MSG
	int "Largest payload accepted by dm_submit()"
	default 240
	help
	  Must not exceed DM_SLAB_BLOCK - 16. Messages are never fragmented by
	  Dockmaster.

config DM_Q_DEPTH_C0
	int "C0 (control) queue depth"
	default 8
	range 1 255

config DM_Q_DEPTH_C1
	int "C1 (state) queue depth"
	default 8
	range 1 255

config DM_Q_DEPTH_C2
	int "C2 (media) queue depth"
	default 16
	range 1 255

config DM_Q_DEPTH_C3
	int "C3 (events) queue depth"
	default 16
	range 1 255

config DM_Q_DEPTH_C4
	int "C4 (bulk) queue depth"
	default 16
	range 1 255

config DM_DUP_WINDOW_MS
	int "How long a duplicate copy waits for a second link (ms)"
	default 2000
	help
	  A DUP message whose second link is not eligible keeps its block for
	  max_age_ms of its class, or for this long when the class has no age
	  limit. After that the second copy is abandoned.

config DM_NOCACHE_SECTION
	bool "Place the slab in the board's non-cacheable section"
	depends on NOCACHE_MEMORY
	help
	  For Cortex-M7 targets with D-cache, so DMA-fed drivers can transmit
	  straight from a slab block.

endmenu

menu "Threads"

config DM_SCHED_PRIO
	int "Scheduler thread priority (preemptible)"
	default 4
	range 0 NUM_PREEMPT_PRIORITIES
	help
	  Must be numerically lower (more urgent) than every owner thread.
	  Cooperative priorities are not allowed.

config DM_SCHED_STACK
	int "Scheduler thread stack size"
	default 1536

config DM_DEFAULT_OWNER_STACK
	int "Owner thread stack size"
	default 2048
	help
	  Size of each statically allocated owner thread stack. A link may ask
	  for less through dm_link_caps::owner_stack, never more.

config DM_LINK_SLOTS
	int "Number of links (and owner thread stacks) reserved"
	default 4
	range 1 8

endmenu

menu "Link manager"

config DM_SWITCH_MARGIN_PCT
	int "Score margin a new link must beat the current one by (%)"
	default 20
	range 0 200

config DM_FLAP_HALFLIFE_S
	int "Flap penalty half-life (s)"
	default 60
	range 1 3600

config DM_PROBE_FAIL_N
	int "Consecutive failed probes before a link goes DEGRADED"
	default 3
	range 1 255

config DM_FAULT_N
	int "Watchdog faults without a success before a link goes DEGRADED"
	default 3
	range 1 255

config DM_W_TPUT
	int "Score weight: throughput"
	default 250
	range 0 1000

config DM_W_RTT
	int "Score weight: round-trip time"
	default 150
	range 0 1000

config DM_W_LOSS
	int "Score weight: loss"
	default 250
	range 0 1000

config DM_W_FLAP
	int "Score weight: flap penalty"
	default 100
	range 0 1000

config DM_W_COST
	int "Score weight: metered cost"
	default 100
	range 0 1000

config DM_W_STATE
	int "Score weight: link state"
	default 150
	range 0 1000

endmenu

menuconfig DM_EDCA
	bool "Software EDCA for DM_TIER_SW links that expose is_busy"
	default y
	help
	  Before transmitting, the owner thread waits AIFS plus a random part
	  of the contention window and re-checks is_busy, doubling the window
	  on a busy medium. The wait is k_sleep on the owner thread.

if DM_EDCA

config DM_EDCA_RETRIES
	int "Busy retries before giving up with -EBUSY"
	default 4

config DM_EDCA_AIFS_US_C0
	int "C0 AIFS (us)"
	default 2000

config DM_EDCA_AIFS_US_C1
	int "C1 AIFS (us)"
	default 5000

config DM_EDCA_AIFS_US_C2
	int "C2 AIFS (us)"
	default 10000

config DM_EDCA_AIFS_US_C3
	int "C3 AIFS (us)"
	default 25000

config DM_EDCA_AIFS_US_C4
	int "C4 AIFS (us)"
	default 50000

config DM_EDCA_CW_US_C0
	int "C0 initial contention window (us)"
	default 8000

config DM_EDCA_CW_US_C1
	int "C1 initial contention window (us)"
	default 20000

config DM_EDCA_CW_US_C2
	int "C2 initial contention window (us)"
	default 50000

config DM_EDCA_CW_US_C3
	int "C3 initial contention window (us)"
	default 200000

config DM_EDCA_CW_US_C4
	int "C4 initial contention window (us)"
	default 400000

endif # DM_EDCA

menu "Interrupts and hardware tier"

config DM_TIER_HW_NRF
	bool "DM_TIER_HW backend for nRF52/nRF53 (GPIOTE -> PPI/DPPI -> EGU)"
	depends on SOC_SERIES_NRF52 || SOC_SERIES_NRF53
	depends on GPIO_NRFX_INTERRUPT
	depends on $(dt_compat_enabled,$(DT_COMPAT_DM_HW_NRF_EGU))
	select NRFX_GPPI
	help
	  Routes per-class completion lines from an external radio to separate
	  EGU interrupts at different NVIC priorities.

config DM_ISR_ASSERTS
	bool "Assert the ISR rules at run time"
	default y if ASSERT
	help
	  Checks that Dockmaster ISR paths never call into the scheduler and
	  that dm_link_tx_done() is called once per accepted tx.

config DM_C0_LOSS_FATAL
	bool "k_oops() when a C0 message is lost"

endmenu

menu "Observability"

config DM_SHELL
	bool "Dockmaster shell commands"
	depends on SHELL

config DM_TRACING
	bool "Trace points through the tracing subsystem"
	depends on TRACING
	help
	  dm_submit, dm_sched_pick, dm_owner_tx, dm_tx_done, dm_switch and
	  dm_shed as named events (SEGGER SystemView, Percepio, CTF).

config DM_GPIO_PROBES
	bool "Toggle two GPIOs on ISR entry and owner tx"
	depends on GPIO
	depends on $(dt_compat_enabled,$(DT_COMPAT_DM_GPIO_PROBES))

endmenu

config DM_TEST_HOOKS
	bool "Test hooks: manual scheduler rounds, fake clock, full reset"
	depends on ZTEST
	help
	  Only for the ztest suites. Never enable in a product.

module = DM
module-str = Dockmaster
source "subsys/logging/Kconfig.template.log_config"

rsource "drivers/dockmaster_link/Kconfig"

endif # DOCKMASTER
```

## drivers/dockmaster_link/Kconfig
```kconfig
# Copyright (c) 2026 Nurzaman
# SPDX-License-Identifier: Apache-2.0

DT_COMPAT_DM_LINK := dockmaster,link
DT_COMPAT_DM_SPI_PHY := dockmaster,spi-phy
DT_COMPAT_DM_NCP_UART := dockmaster,ncp-uart

menu "Dockmaster link drivers"

config DM_LINK_FAKE
	bool "Fake link with configurable latency, loss and busy periods"
	help
	  Pure software link used by every unit test and by the native_sim
	  sample. Runs on any board.

config DM_LINK_FAKE_COUNT
	int "Number of fake link instances"
	depends on DM_LINK_FAKE
	default 2
	range 1 8

config DM_LINK_SPI_PHY
	bool "Generic external PHY on SPI"
	default y
	depends on $(dt_compat_enabled,$(DT_COMPAT_DM_SPI_PHY))
	depends on SPI && GPIO
	help
	  Command + FIFO transceiver on SPI with a TX-done pin and an optional
	  busy pin (dockmaster,spi-phy). DM_TIER_SW by default, DM_TIER_HW
	  with class-line pins and a tier 0 backend.

config DM_LINK_SPI_PHY_INIT_PRIORITY
	int "SPI PHY link init priority"
	depends on DM_LINK_SPI_PHY
	default 90
	help
	  POST_KERNEL priority. Must come after the SPI and GPIO drivers.

config DM_LINK_NCP_UART
	bool "Network co-processor on a UART"
	default y
	depends on $(dt_compat_enabled,$(DT_COMPAT_DM_NCP_UART))
	depends on SERIAL && UART_INTERRUPT_DRIVEN
	help
	  Line-oriented request/response link to a co-processor such as a
	  cellular modem (dockmaster,ncp-uart). Metered, DM_TIER_SW, with a
	  round-trip probe.

config DM_LINK_NCP_UART_INIT_PRIORITY
	int "NCP UART link init priority"
	depends on DM_LINK_NCP_UART
	default 90
	help
	  POST_KERNEL priority. Must come after the UART driver.

config DM_LINK_IEEE802154
	bool "On-chip IEEE 802.15.4 radio"
	default y
	depends on $(dt_compat_enabled,$(DT_COMPAT_DM_LINK))
	depends on IEEE802154
	help
	  Wraps Zephyr's IEEE 802.15.4 radio API (dockmaster,link whose
	  backend is the radio). DM_TIER_MAC with two levels: direct
	  transmission for C0 to C2, CSMA-CA (or CCA) for C3 and C4. Meant for
	  CONFIG_IEEE802154_RAW_MODE, where Dockmaster is the only transmitter.

if DM_LINK_IEEE802154

config DM_LINK_IEEE802154_INIT_PRIORITY
	int "IEEE 802.15.4 link init priority"
	default 90
	help
	  POST_KERNEL priority. Must come after the radio driver (for example
	  CONFIG_IEEE802154_NRF5_INIT_PRIO, 80 by default).

config DM_LINK_IEEE802154_CHANNEL
	int "Channel (2.4 GHz O-QPSK)"
	default 26
	range 11 26

config DM_LINK_IEEE802154_PAN_ID
	hex "PAN ID"
	default 0xabcd
	range 0x0 0xfffe

config DM_LINK_IEEE802154_SHORT_ADDR
	hex "Own short address"
	default 0x0001
	range 0x0 0xfffd

config DM_LINK_IEEE802154_DST_ADDR
	hex "Destination short address"
	default 0xffff
	range 0x0 0xffff
	help
	  0xffff broadcasts without acknowledgement. Any other address asks
	  for an ACK when the radio waits for ACKs itself
	  (IEEE802154_HW_TX_RX_ACK); a missing ACK fails the transmission.

endif # DM_LINK_IEEE802154

endmenu
```

## dts/bindings/dockmaster/dockmaster,gpio-probes.yaml
```yaml
# Copyright (c) 2026 Nurzaman
# SPDX-License-Identifier: Apache-2.0

description: |
  Two GPIO probe points for latency measurements with a logic analyser
  (spec section 13, CONFIG_DM_GPIO_PROBES). Pin A toggles when a link
  driver reports a completion with dm_link_tx_done() from interrupt
  context, pin B toggles when an owner thread calls a driver's tx. Both
  toggle (rather than pulse), so every edge is one event.

  Example:

    dm-probes {
        compatible = "dockmaster,gpio-probes";
        gpios = <&gpio0 3 GPIO_ACTIVE_HIGH>, <&gpio0 4 GPIO_ACTIVE_HIGH>;
    };

compatible: "dockmaster,gpio-probes"

include: base.yaml

properties:
  gpios:
    type: phandle-array
    required: true
    description: |
      Exactly two entries: pin A (completion in interrupt context), then
      pin B (owner thread tx call).
```

## dts/bindings/dockmaster/dockmaster,hw-nrf-egu.yaml
```yaml
# Copyright (c) 2026 Nurzaman
# SPDX-License-Identifier: Apache-2.0

description: |
  DM_TIER_HW backend for nRF52 (PPI) and nRF53 (DPPI), spec section 11.
  Enable it with CONFIG_DM_TIER_HW_NRF=y.

  The node describes two class lines. Line 0 carries the completions of
  classes C0 to C2, line 1 those of C3 and C4. Each line is a chain fixed
  at bind time:

    SoC input pin -> GPIOTE IN[channel] -> (D)PPI -> EGU[instance].TRIGGER[0]

  and the EGU interrupt of line 0 runs at the DM_IRQ_HW_C0 NVIC level, the
  one of line 1 at DM_IRQ_HW_C4, so a C0 to C2 completion preempts a C3 or
  C4 completion handler. Entry i of every property below belongs to line i.

  The (D)PPI channel is not listed: it comes from the nrfx_gppi allocator
  so that it never collides with a radio driver or a Bluetooth controller.
  The GPIOTE channel is claimed from the nrfx GPIOTE pool at bind time and
  its interrupt stays disabled, so GPIOTE_IRQn never fires for a line.

  Pick EGU instances nothing else uses: on nRF52 the 802.15.4 radio driver
  takes EGU0 and Zephyr's Bluetooth controller uses SWI/EGU instances too.

  Example (nRF52840):

    dm_tier0: dm-tier0 {
        compatible = "dockmaster,hw-nrf-egu";
        egu-instances = <2 3>;
        gpiote-channels = <6 7>;
        line-gpios = <&gpio1 5 GPIO_ACTIVE_HIGH>, <&gpio1 6 GPIO_ACTIVE_HIGH>;
    };

compatible: "dockmaster,hw-nrf-egu"

include: base.yaml

properties:
  egu-instances:
    type: array
    required: true
    description: |
      EGU instance number per line, two distinct entries. The node with
      label egu<n> must exist and be enabled.

  gpiote-channels:
    type: array
    required: true
    description: |
      GPIOTE IN channel per line, two distinct entries, on the GPIOTE
      instance that serves the line's pin.

  line-gpios:
    type: phandle-array
    required: true
    description: |
      SoC input per line, wired to the radio output that signals a finished
      transmission of that line's classes. GPIO_ACTIVE_LOW makes the falling
      edge the event.
```

## dts/bindings/dockmaster/dockmaster,link-common.yaml
```yaml
# Copyright (c) 2026 Nurzaman
# SPDX-License-Identifier: Apache-2.0

description: |
  Properties shared by every Dockmaster link node (spec section 14). This
  file has no compatible: link driver bindings include it.

properties:
  owner-priority:
    type: int
    description: |
      Zephyr thread priority of the link's owner thread. It must be
      preemptible and, unless the link is DM_TIER_MAC, numerically above
      CONFIG_DM_SCHED_PRIO. Omit it (or use 0) to derive it from the link:
      CONFIG_DM_SCHED_PRIO + 1 for tier "mac", + 2 for tier "sw" and "hw",
      + 3 for metered links.

  owner-stack:
    type: int
    description: |
      Owner thread stack size in bytes. Omit it to use
      CONFIG_DM_DEFAULT_OWNER_STACK. Registration rejects larger values,
      because every owner stack is a static CONFIG_DM_DEFAULT_OWNER_STACK
      block.

  tier:
    type: string
    enum:
      - "sw"
      - "mac"
      - "hw"
    description: |
      How strictly the link separates classes (spec section 2):
      "sw" Dockmaster queues only (plus sw-EDCA when the link has is_busy),
      "mac" the link has native priority slots, "hw" the SoC routes each
      class's completion to its own NVIC line (needs a DM_TIER_HW backend).
      The enum order matches DM_TIER_SW, DM_TIER_MAC, DM_TIER_HW. Each
      driver picks its own default and rejects tiers it cannot provide.

  metered:
    type: boolean
    description: |
      Bytes on this link cost money. Classes with the EXCLUSIVE_NO_METERED
      policy flag (C4 by default) never use it.

  probe-period-ms:
    type: int
    default: 0
    description: |
      Period of the end-to-end probe in milliseconds, 0 for none. Ignored by
      drivers that have no probe operation.
```

## dts/bindings/dockmaster/dockmaster,link.yaml
```yaml
# Copyright (c) 2026 Nurzaman
# SPDX-License-Identifier: Apache-2.0

description: |
  A Dockmaster link whose transport is another Zephyr device, named by
  the backend phandle. In this version the only driver for this compatible
  is dm_link_onchip_ieee802154.c, so backend must point at an IEEE 802.15.4
  radio (for example &ieee802154 on nRF52840).

  Example:

    radio_a: dm-link-a {
        compatible = "dockmaster,link";
        backend = <&ieee802154>;
        tier = "mac";
        owner-priority = <5>;
    };

compatible: "dockmaster,link"

include:
  - base.yaml
  - "dockmaster,link-common.yaml"

properties:
  backend:
    type: phandle
    required: true
    description: The device that carries this link's traffic.
```
